## main/Kconfig.projbuild
```kconfig
menu "Example Configuration"

    config EXAMPLE_PORT
        int "Port"
        range 0 65535
        default 3333
        help
            Local port the example server will listen on.

    config EXAMPLE_PORT_2
        int "Port 2"
        range 0 65535
        default 3334
        help
            Local port the second example server will listen on.

	config EXAMPLE_STATIC_IP_ADDR
        string "wESP32 Static IP address"
        default "192.168.98.124"
        help
            Set static IP address for wESP32

    config EXAMPLE_STATIC_NETMASK_ADDR
        string "wESP32 Static netmask address"
        default "255.255.255.0"
        help
            Set static netmask address for wESP32
	
    config HOST_IP_ADDR
        string "Host computer static IP address"
        default "192.168.98.44"
        help
            Specify static ip address for host computer

	config GPIO_JUICE
        int "Juice GPIO"
        default 14
        help
			GPIO number on wEsp32 to control juicer.

	config GPIO_LIGHT_ON
        int "Light On GPIO"
        default 5
        help
			GPIO number on wESP32 to control when lights get turned on.

	config GPIO_LIGHT_OFF
        int "Light Off GPIO"
        default 4
        help
			GPIO number on wESP32 to control when lights get turned off.

    config GPIO_SERIAL_TX
        int "Serial TX GPIO"
        default 33
        help
            GPIO number on wEsp32 for serial transmission.

    config GPIO_SERIAL_RX
        int "Serial RX GPIO"
        default 39
        help
            GPIO number on wEsp32 for serial reception.

	config PULSE_LENGTH_MSEC
        int "Pulse length in miliseconds"
        default 1000
        help
			Length of the GPIO pulse in miliseconds

	config TIMEOUT_SOCKET_SEC
        int "Timeout of the socket in seconds"
        default 300
        help
			Length of the timeout of the socket in seconds before socket restarts

	config TIMEOUT_SOCKET_USEC
        int "Timeout of the socket in microseconds"
        default 0
        help
			Length of the timeout of the socket in microseconds

endmenu
```

## projects/sample_project/main/Kconfig.projbuild
```kconfig
menu "Example Configuration"

    config EXAMPLE_IPV4
        bool "IPV4"
        default y

    config EXAMPLE_IPV6
        bool "IPV6"
        default n
        select EXAMPLE_CONNECT_IPV6

    config EXAMPLE_PORT
        int "Port"
        range 0 65535
        default 3333
        help
            Local port the example server will listen on.

	config EXAMPLE_STATIC_IP_ADDR
        string "Static IP address"
        default "192.168.52.124"
        help
            Set static IP address.

    config EXAMPLE_STATIC_NETMASK_ADDR
        string "Static netmask address"
        default "255.255.255.0"
        help
            Set static netmask address.


	config GPIO_JUICE
        int "Juice GPIO"
        default 14
        help
			GPIO number on wEsp32 to control juicer.

	config GPIO_LIGHT_ON
        int "Light On GPIO"
        default 5
        help
			GPIO number on wESP32 to control when lights get turned on.

	config GPIO_LIGHT_OFF
        int "Light Off GPIO"
        default 4
        help
			GPIO number on wESP32 to control when lights get turned off.

	config PULSE_LENGTH_MSEC
        int "Pulse length in miliseconds"
        default 1000
        help
			Length of the GPIO pulse in miliseconds

	config TIMEOUT_SOCKET_SEC
        int "Timeout of the socket in seconds"
        default 300
        help
			Length of the timeout of the socket in seconds before socket restarts

	config TIMEOUT_SOCKET_USEC
        int "Timeout of the socket in microseconds"
        default 0
        help
			Length of the timeout of the socket in microseconds

endmenu
```
